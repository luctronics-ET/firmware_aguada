## firmware/node_cie_dual/Kconfig.projbuild
```kconfig
menu "Node CIE Dual Options"

config LED_ACTIVE_HIGH
    bool "LED embutido ativo em nivel alto"
    default n
    help
        Ajuste para 'y' se o LED onboard for ativo em nivel alto.
        Por padrão, fica em nivel baixo (active-low) comum no ESP32-C3 Supermini.

endmenu
```

## firmware/node_cie_dual/sdkconfig.defaults
```kconfig
# Node CIE Dual - ESP32-C3 Configuration Overrides
# Dual HC-SR04 sensors for CIE cistern (2 independent reservoirs)

# Uncomment if LED is active-high
# CONFIG_LED_ACTIVE_HIGH=y

# Increase main task stack if needed for dual sensor processing
# CONFIG_ESP_MAIN_TASK_STACK_SIZE=8192
```

## firmware/node_ultra2/sdkconfig.defaults
```kconfig
# Coloque overrides de configuração do ESP-IDF aqui.
# Exemplos úteis:
# CONFIG_LOG_DEFAULT_LEVEL_WARN=y
# CONFIG_ESP_MAIN_TASK_STACK_SIZE=8192
# CONFIG_ESP32_WIFI_STATIC_RX_BUFFER_NUM=8
# CONFIG_LED_ACTIVE_HIGH=y   # descomente se seu LED for ativo-alto
```
